## conf/layer.conf
```bitbake
# We have a conf and classes directory, add to BBPATH
BBPATH .= ":${LAYERDIR}"

LICENSE = "MIT"
LIC_FILES_CHKSUM = "file://${LAYERDIR}/COPYING.MIT;md5=3da9cfbcb788c80a0384361b4de20420"

LICENSE_PATH += "${LAYERDIR}"
# We have recipes-* directories, add to BBFILES
BBFILES += "${LAYERDIR}/recipes-*/*/*.bb \
            ${LAYERDIR}/recipes-*/*/*.bbappend"

PREFERRED_VERSION_rust-cross-${TARGET_ARCH} ?= "1.78"
PREFERRED_VERSION_rust ?= "1.78%"
PREFERRED_VERSION_rust-llvm ?= "1.78%"
PREFERRED_VERSION_rust-llvm-native ?= "1.78%"
PREFERRED_VERSION_rust-native ?= "1.78%"
PREFERRED_VERSION_libstd-rs ?= "1.78%"
PREFERRED_VERSION_cargo-native ?= "1.78%"

BBFILE_COLLECTIONS += "meta-uthp"
BBFILE_PATTERN_meta-uthp = "^${LAYERDIR}/"
BBFILE_PRIORITY_meta-uthp = "98"

LAYERDEPENDS_meta-uthp = "core meta-python meta-python2 networking-layer jupyter-layer arm-toolchain meta-arm meta-ti-bsp meta-ti-extras"
LAYERSERIES_COMPAT_meta-uthp = "scarthgap"
```
