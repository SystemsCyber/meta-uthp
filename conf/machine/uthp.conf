## conf/machine/uthp.conf
```bitbake
#@TYPE: Machine
#@NAME: Ultimate Truck Hacking Platform
#@DESCRIPTION: Custom configuration for UTHP based on BeagleBone

# Inherit settings from beaglebone.conf in meta-ti layer
require conf/machine/beaglebone.conf
# File naming convention for Yocto is image-machine.wks
MACHINE_EXTRA_RRECOMMENDS += "kernel-module-lin"
```
